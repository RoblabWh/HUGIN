/dts-v1/;
/plugin/;

/ {
    overlay-name = "WH IO Breakout";
    jetson-header-name = "Jetson M.2 Key E Slot";
    compatible = "nvidia,p3768-0000+p3767-0001", "nvidia,p3767-0001", "nvidia,tegra234";

    fragment@0 {
        target-path = "/bus@0/serial@3110000";

        __overlay__ {
            compatible = "nvidia,tegra194-hsuart";
            reset-names = "serial";
            status = "okay";
        };
    };

    fragment@1 {
        target-path = "/bus@0/serial@3140000";

        __overlay__ {
            compatible = "nvidia,tegra194-hsuart";
            status = "disabled";
        };
    };

    fragment@2 {
        target-path = "/aliases";

        __overlay__ {
            serial2 = "/bus@0/serial@3110000";
            serial3 = "/bus@0/serial@3140000";
        };
    };
};
